AUTOSAR XML (schema 00049)
package /ActiveEcuC
  module config Mcu: implementation-config-variant=VARIANT-PRE-COMPILE
    McuPublishedInformation
      McuResetReasonConf: McuResetReason=0
      McuRstRsnConfPowOnRst: McuResetReason=0
      McuRstRsnConfTerminalRst: McuResetReason=1
      McuRstRsnConfCvmRst: McuResetReason=2
      McuRstRsnConfSwSysRst: McuResetReason=3
      McuRstRsnConfWdtRst: McuResetReason=4
      McuRstRsnConfLockStepCoreRst: McuResetReason=5
      McuRstRsnConfPbusFssRst: McuResetReason=6
      McuRstRsnConfBusBridgeErrorRst: McuResetReason=7
      McuRstRsnConfSafetyMechCompRst: McuResetReason=8
      McuRstRsnConfTempSensorRst: McuResetReason=9
      McuRstRsnConfClma0Rst: McuResetReason=10
      McuRstRsnConfClma2Rst: McuResetReason=11
      McuRstRsnConfClma3Rst: McuResetReason=12
      McuRstRsnConfClma4Rst: McuResetReason=13
      McuRstRsnConfClma1Rst: McuResetReason=14
      McuRstRsnConfLRamEccDedRst: McuResetReason=15
      McuRstRsnConfGRamEccDedRst: McuResetReason=16
      McuRstRsnConfCacheRamEdcRst: McuResetReason=17
      McuRstRsnConfCodeFlsEccDedRst: McuResetReason=18
      McuRstRsnConfDataFlsEccDedRst: McuResetReason=19
      McuRstRsnConfCsihRamEccDedRst: McuResetReason=20
      McuRstRsnConfCanRamEccDedRst: McuResetReason=21
      McuRstRsnConfEthRamDedRst: McuResetReason=22
      McuRstRsnConfFrRamEccDedRst: McuResetReason=23
      McuRstRsnConfGtmRamEccDedRst: McuResetReason=24
      McuRstRsnConfBusEccDedRst: McuResetReason=25
      McuRstRsnConfBusEccSedRst: McuResetReason=26
      McuRstRsnConfLRamAddrOvfRst: McuResetReason=27
      McuRstRsnConfGRamAddrOvfRst: McuResetReason=28
      McuRstRsnConfCodeFlsAddrOvfRst: McuResetReason=29
      McuRstRsnConfDataFlsAddrOvfRst: McuResetReason=30
      McuRstRsnConfPeriRamEccAddrOvfRst: McuResetReason=31
      McuRstRsnConfDtsRamEccDedRst: McuResetReason=32
      McuRstRsnConfDtsRamEccSedRst: McuResetReason=33
      McuRstRsnConfLRamEccSedRst: McuResetReason=34
      McuRstRsnConfGRamEccSedRst: McuResetReason=35
      McuRstRsnConfCodeFlsEccSedRst: McuResetReason=36
      McuRstRsnConfDataFlsEccSedRst: McuResetReason=37
      McuRstRsnConfCsihRamEccSedRst: McuResetReason=38
      McuRstRsnConfCanRamEccSedRst: McuResetReason=39
      McuRstRsnConfEthRamEccSedRst: McuResetReason=40
      McuRstRsnConfFrRamEccSedRst: McuResetReason=41
      McuRstRsnConfGtmRamEccSedRst: McuResetReason=42
      McuRstRsnConfPEGuardRst: McuResetReason=43
      McuRstRsnConfGramGuardRst: McuResetReason=44
      McuRstRsnConfMemcGuardRst: McuResetReason=45
      McuRstRsnConfSlaveGuardRst: McuResetReason=46
      McuRstRsnConfCodeFlsPEUnmapAccessRst: McuResetReason=47
      McuRstRsnConfGramPEUnmapAccessRst: McuResetReason=48
      McuRstRsnConfLpbPEUnmapAccessRst: McuResetReason=49
      McuRstRsnConfPBusUnmapAccessRst: McuResetReason=50
      McuRstRsnConfHBusUnmapAccessRst: McuResetReason=51
      McuRstRsnConfCodeFlsGvciUnmapAccessRst: McuResetReason=52
      McuRstRsnConfGramFlsGvciUnmapAccessRst: McuResetReason=53
      McuRstRsnConfResHbusUnmapAccessRst: McuResetReason=54
      McuRstRsnConfDmaTransferRst: McuResetReason=55
      McuRstRsnConfDmaUnmappedRst: McuResetReason=56
      McuRstRsnConfFlsSequenceRst: McuResetReason=57
      McuRstRsnConfFlsFaciRst: McuResetReason=58
      McuRstRsnConfAdcParityRst: McuResetReason=59
      McuRstRsnConfPEUnintenEnableDisableRst: McuResetReason=60
      McuRstRsnConfUnintenDeactUserRst: McuResetReason=61
      McuRstRsnConfUnintenActCfpModeRst: McuResetReason=62
      McuRstRsnConfUnintenDebugEnableDetectRst: McuResetReason=63
      McuRstRsnConfUnintenActTestModeRst: McuResetReason=64
      McuRstRsnConfEcmCompRst: McuResetReason=65
      McuRstRsnConfSwApplRst: McuResetReason=66
      McuRstRsnConfEcmDelayTmrOvfRst: McuResetReason=67
      McuRstRsnConfRstUndefined: McuResetReason=68
      McuRstRsnConfRstUnknown: McuResetReason=69
      McuRstRsnConfMultipleRst: McuResetReason=70
    McuGeneralConfiguration:
      McuVersionCheckExternalModules = true
      McuDevErrorDetect = true
      McuGetRamStateApi = true
      McuInitClock = true
      McuNoPll = false
      McuPerformResetApi = true
      McuVersionInfoApi = true
      McuCriticalSectionProtection = true
      McuSwResetCallApi = true
      McuEcmDelayTimerOverflowValue = 65535
      McuEcmErrorOutputMode = NON_DYNAMIC_MODE
      McuClm0Operation = true
      McuClm0MonitoringClockAccuracy = 0
      McuClm0SamplingClockAccuracy = 6
      McuClm1Operation = true
      McuClm1MonitoringClockAccuracy = 9
      McuClm1SamplingClockAccuracy = 9
      McuClm2Operation = true
      McuClm2MonitoringClockAccuracy = 9
      McuClm2SamplingClockAccuracy = 9
      McuClm3Operation = true
      McuClm3MonitoringClockAccuracy = 9
      McuClm3SamplingClockAccuracy = 9
      McuClm4Operation = true
      McuClm4MonitoringClockAccuracy = 9
      McuClm4SamplingClockAccuracy = 9
      McuClma{0..4}SelfDiagnosticTest = true
      McuLoopCount = 28
      McuEcmRstConfigure = APPLICATION_RESET
      McuRamSectorSetting = true
      McuDeviceName = R7F701372A
      McuGTMConfigurationSupport = true
      McuInterruptConsistencyCheck = true
      McuWriteVerify = WV_INIT_RUNTIME
      McuUseWriteVerifyErrorInterface = false
      McuCvmSelfDiagnosticTest = true
      McuEcmSelfDiagnosticTest = true
      McuLockStepSelfDiagnosticTest = true
      McuMultipleResetSupport = true
      McuWriteVerifyErrorInterface = NULL
    McuModuleConfiguration:
      McuClockSrcFailureNotification = DISABLED
      McuNumberOfMcuModes = 1
      McuRamSectors = 1
      McuCvmOutMaskFbist = false
      McuCvmOutMaskDiag = false
      McuCvmOutputFilter = false
      McuCvmDiagLockBit = true
      McuCvmResetEnable = false
      McuSwResetTrigger = NO_RESET
      McuClockSettingConfig: McuClockSettingId=1, McuMainOsciFrequency=FREQ_20000000, McuCpuMainSysClk=240000000, McuUnitName=CLK_CPUM
        McuInternalOscillatorClk: McuPeripheralClock=16000000
        McuExternalClkOutSetting:
          McuExternalClk0SourceSel = MCU_BACKUP_CLOCK
          McuExternalClk0DividerSel = 1
          McuExternalClock0 = 8000000
          McuExternalClk1SourceSel = MCU_BACKUP_CLOCK
          McuExternalClk1DividerSel = 1
          McuExternalClock1 = 8000000
        McuPLLClkSetting: McuSystemSourceSel=MCU_PLL, McuPLLClk0DividerSel=1, McuPLLClock0=480000000, McuPLLClk1DividerSel=1, McuOPBT1Sel=3221211512
        McuSAWdtCounterClk: McuSAWdtCounterDivider=DIVBY_ID_8, McuUnitName=WDTCLKI, McuPeripheralClock=2000
        McuClockReferencePoint: McuClockReferencePointFrequency=160000000
      McuGTMClockSettingsConfig: McuGTMCMUGCLKNumerator=1, McuGTMCMUGCLKDenominator=1
        McuGTMClockSettings: McuGTMClockSelection=CMU_CLK0, McuGTMChannelClkSrcDivider=80
      McuEcmErrorSourcesCfg
        McuEcmErrorSource0:
          McuEcmErrorMaskableInterrupt = false
          McuEcmErrorNonMaskableInterrupt = false
          McuEcmErrorInternalReset = false
          McuEcmErrorNMIDelayTimer = false
          McuEcmErrorMIDelayTimer = false
          McuEcmErrorOutputMask = true
        McuEcmErrorSource1:
          McuEcmErrorMaskableInterrupt = false
          McuEcmErrorNonMaskableInterrupt = false
          McuEcmErrorInternalReset = false
          McuEcmErrorNMIDelayTimer = false
          McuEcmErrorMIDelayTimer = false
          McuEcmErrorOutputMask = true
        McuEcmErrorSource2:
          McuEcmErrorMaskableInterrupt = false
          McuEcmErrorNonMaskableInterrupt = false
          McuEcmErrorInternalReset = false
          McuEcmErrorNMIDelayTimer = false
          McuEcmErrorMIDelayTimer = false
          McuEcmErrorOutputMask = true
        McuEcmErrorSource3:
          McuEcmErrorMaskableInterrupt = false
          McuEcmErrorNonMaskableInterrupt = false
          McuEcmErrorInternalReset = false
          McuEcmErrorNMIDelayTimer = false
          McuEcmErrorMIDelayTimer = false
          McuEcmErrorOutputMask = true
        McuEcmErrorSource4:
          McuEcmErrorMaskableInterrupt = false
          McuEcmErrorNonMaskableInterrupt = false
          McuEcmErrorInternalReset = false
          McuEcmErrorNMIDelayTimer = false
          McuEcmErrorMIDelayTimer = false
          McuEcmErrorOutputMask = true
        McuEcmErrorSource6:
          McuEcmErrorMaskableInterrupt = false
          McuEcmErrorNonMaskableInterrupt = false
          McuEcmErrorInternalReset = false
          McuEcmErrorNMIDelayTimer = false
          McuEcmErrorMIDelayTimer = false
          McuEcmErrorOutputMask = true
        McuEcmErrorSource8:
          McuEcmErrorMaskableInterrupt = false
          McuEcmErrorNonMaskableInterrupt = false
          McuEcmErrorInternalReset = false
          McuEcmErrorNMIDelayTimer = false
          McuEcmErrorMIDelayTimer = false
          McuEcmErrorOutputMask = true
        McuEcmErrorSource9:
          McuEcmErrorMaskableInterrupt = false
          McuEcmErrorNonMaskableInterrupt = false
          McuEcmErrorInternalReset = false
          McuEcmErrorNMIDelayTimer = false
          McuEcmErrorMIDelayTimer = false
          McuEcmErrorOutputMask = true
        McuEcmErrorSource10:
          McuEcmErrorMaskableInterrupt = false
          McuEcmErrorNonMaskableInterrupt = false
          McuEcmErrorInternalReset = false
          McuEcmErrorNMIDelayTimer = false
          McuEcmErrorMIDelayTimer = false
          McuEcmErrorOutputMask = true
        McuEcmErrorSource12:
          McuEcmErrorMaskableInterrupt = false
          McuEcmErrorNonMaskableInterrupt = false
          McuEcmErrorInternalReset = false
          McuEcmErrorNMIDelayTimer = false
          McuEcmErrorMIDelayTimer = false
          McuEcmErrorOutputMask = true
        McuEcmErrorSource16:
          McuEcmErrorMaskableInterrupt = true
          McuEcmErrorNonMaskableInterrupt = false
          McuEcmErrorInternalReset = false
          McuEcmErrorNMIDelayTimer = false
          McuEcmErrorMIDelayTimer = false
          McuEcmErrorOutputMask = true
          McuEcmInitialNotification = NULL_PTR
          McuMiNotification = NULL_PTR
          McuNmiNotification = NULL_PTR
        McuEcmErrorSource17:
          McuEcmErrorMaskableInterrupt = true
          McuEcmErrorNonMaskableInterrupt = false
          McuEcmErrorInternalReset = false
          McuEcmErrorNMIDelayTimer = false
          McuEcmErrorMIDelayTimer = false
          McuEcmErrorOutputMask = true
          McuEcmInitialNotification = NULL_PTR
          McuMiNotification = NULL_PTR
          McuNmiNotification = NULL_PTR
        McuEcmErrorSource18:
          McuEcmErrorMaskableInterrupt = false
          McuEcmErrorNonMaskableInterrupt = false
          McuEcmErrorInternalReset = false
          McuEcmErrorNMIDelayTimer = false
          McuEcmErrorMIDelayTimer = false
          McuEcmErrorOutputMask = true
        McuEcmErrorSource19:
          McuEcmErrorMaskableInterrupt = false
          McuEcmErrorNonMaskableInterrupt = false
          McuEcmErrorInternalReset = false
          McuEcmErrorNMIDelayTimer = false
          McuEcmErrorMIDelayTimer = false
          McuEcmErrorOutputMask = true
        McuEcmErrorSource20:
          McuEcmErrorMaskableInterrupt = false
          McuEcmErrorNonMaskableInterrupt = false
          McuEcmErrorInternalReset = false
          McuEcmErrorNMIDelayTimer = false
          McuEcmErrorMIDelayTimer = false
          McuEcmErrorOutputMask = true
        McuEcmErrorSource21:
          McuEcmErrorMaskableInterrupt = false
          McuEcmErrorNonMaskableInterrupt = false
          McuEcmErrorInternalReset = false
          McuEcmErrorNMIDelayTimer = false
          McuEcmErrorMIDelayTimer = false
          McuEcmErrorOutputMask = true
        McuEcmErrorSource22:
          McuEcmErrorMaskableInterrupt = false
          McuEcmErrorNonMaskableInterrupt = false
          McuEcmErrorInternalReset = false
          McuEcmErrorNMIDelayTimer = false
          McuEcmErrorMIDelayTimer = false
          McuEcmErrorOutputMask = true
        McuEcmErrorSource23:
          McuEcmErrorMaskableInterrupt = false
          McuEcmErrorNonMaskableInterrupt = false
          McuEcmErrorInternalReset = false
          McuEcmErrorNMIDelayTimer = false
          McuEcmErrorMIDelayTimer = false
          McuEcmErrorOutputMask = true
        McuEcmErrorSource24:
          McuEcmErrorMaskableInterrupt = false
          McuEcmErrorNonMaskableInterrupt = false
          McuEcmErrorInternalReset = false
          McuEcmErrorNMIDelayTimer = false
          McuEcmErrorMIDelayTimer = false
          McuEcmErrorOutputMask = true
        McuEcmErrorSource25:
          McuEcmErrorMaskableInterrupt = false
          McuEcmErrorNonMaskableInterrupt = false
          McuEcmErrorInternalReset = false
          McuEcmErrorNMIDelayTimer = false
          McuEcmErrorMIDelayTimer = false
          McuEcmErrorOutputMask = true
        McuEcmErrorSource28:
          McuEcmErrorMaskableInterrupt = false
          McuEcmErrorNonMaskableInterrupt = false
          McuEcmErrorInternalReset = false
          McuEcmErrorNMIDelayTimer = false
          McuEcmErrorMIDelayTimer = false
          McuEcmErrorOutputMask = true
        McuEcmErrorSource29:
          McuEcmErrorMaskableInterrupt = false
          McuEcmErrorNonMaskableInterrupt = false
          McuEcmErrorInternalReset = false
          McuEcmErrorNMIDelayTimer = false
          McuEcmErrorMIDelayTimer = false
          McuEcmErrorOutputMask = true
        McuEcmErrorSource32:
          McuEcmErrorMaskableInterrupt = false
          McuEcmErrorNonMaskableInterrupt = false
          McuEcmErrorInternalReset = false
          McuEcmErrorNMIDelayTimer = false
          McuEcmErrorMIDelayTimer = false
          McuEcmErrorOutputMask = true
        McuEcmErrorSource33:
          McuEcmErrorMaskableInterrupt = false
          McuEcmErrorNonMaskableInterrupt = false
          McuEcmErrorInternalReset = false
          McuEcmErrorNMIDelayTimer = false
          McuEcmErrorMIDelayTimer = false
          McuEcmErrorOutputMask = true
        McuEcmErrorSource35:
          McuEcmErrorMaskableInterrupt = false
          McuEcmErrorNonMaskableInterrupt = false
          McuEcmErrorInternalReset = false
          McuEcmErrorNMIDelayTimer = false
          McuEcmErrorMIDelayTimer = false
          McuEcmErrorOutputMask = true
        McuEcmErrorSource36:
          McuEcmErrorMaskableInterrupt = false
          McuEcmErrorNonMaskableInterrupt = false
          McuEcmErrorInternalReset = false
          McuEcmErrorNMIDelayTimer = false
          McuEcmErrorMIDelayTimer = false
          McuEcmErrorOutputMask = true
        McuEcmErrorSource37:
          McuEcmErrorMaskableInterrupt = false
          McuEcmErrorNonMaskableInterrupt = false
          McuEcmErrorInternalReset = false
          McuEcmErrorNMIDelayTimer = false
          McuEcmErrorMIDelayTimer = false
          McuEcmErrorOutputMask = true
        McuEcmErrorSource40:
          McuEcmErrorMaskableInterrupt = false
          McuEcmErrorNonMaskableInterrupt = false
          McuEcmErrorInternalReset = false
          McuEcmErrorNMIDelayTimer = false
          McuEcmErrorMIDelayTimer = false
          McuEcmErrorOutputMask = true
        McuEcmErrorSource41:
          McuEcmErrorMaskableInterrupt = false
          McuEcmErrorNonMaskableInterrupt = false
          McuEcmErrorInternalReset = false
          McuEcmErrorNMIDelayTimer = false
          McuEcmErrorMIDelayTimer = false
          McuEcmErrorOutputMask = true
        McuEcmErrorSource48:
          McuEcmErrorMaskableInterrupt = true
          McuEcmErrorNonMaskableInterrupt = false
          McuEcmErrorInternalReset = false
          McuEcmErrorNMIDelayTimer = false
          McuEcmErrorMIDelayTimer = false
          McuEcmErrorOutputMask = true
          McuEcmInitialNotification = NULL_PTR
          McuMiNotification = NULL_PTR
          McuNmiNotification = NULL_PTR
        McuEcmErrorSource49:
          McuEcmErrorMaskableInterrupt = true
          McuEcmErrorNonMaskableInterrupt = false
          McuEcmErrorInternalReset = false
          McuEcmErrorNMIDelayTimer = false
          McuEcmErrorMIDelayTimer = false
          McuEcmErrorOutputMask = true
          McuEcmInitialNotification = NULL_PTR
          McuMiNotification = NULL_PTR
          McuNmiNotification = NULL_PTR
        McuEcmErrorSource51:
          McuEcmErrorMaskableInterrupt = false
          McuEcmErrorNonMaskableInterrupt = false
          McuEcmErrorInternalReset = false
          McuEcmErrorNMIDelayTimer = false
          McuEcmErrorMIDelayTimer = false
          McuEcmErrorOutputMask = true
        McuEcmErrorSource52:
          McuEcmErrorMaskableInterrupt = false
          McuEcmErrorNonMaskableInterrupt = false
          McuEcmErrorInternalReset = false
          McuEcmErrorNMIDelayTimer = false
          McuEcmErrorMIDelayTimer = false
          McuEcmErrorOutputMask = true
        McuEcmErrorSource53:
          McuEcmErrorMaskableInterrupt = false
          McuEcmErrorNonMaskableInterrupt = false
          McuEcmErrorInternalReset = false
          McuEcmErrorNMIDelayTimer = false
          McuEcmErrorMIDelayTimer = false
          McuEcmErrorOutputMask = true
        McuEcmErrorSource54:
          McuEcmErrorMaskableInterrupt = false
          McuEcmErrorNonMaskableInterrupt = false
          McuEcmErrorInternalReset = false
          McuEcmErrorNMIDelayTimer = false
          McuEcmErrorMIDelayTimer = false
          McuEcmErrorOutputMask = true
        McuEcmErrorSource55:
          McuEcmErrorMaskableInterrupt = false
          McuEcmErrorNonMaskableInterrupt = false
          McuEcmErrorInternalReset = false
          McuEcmErrorNMIDelayTimer = false
          McuEcmErrorMIDelayTimer = false
          McuEcmErrorOutputMask = true
        McuEcmErrorSource56:
          McuEcmErrorMaskableInterrupt = false
          McuEcmErrorNonMaskableInterrupt = false
          McuEcmErrorInternalReset = false
          McuEcmErrorNMIDelayTimer = false
          McuEcmErrorMIDelayTimer = false
          McuEcmErrorOutputMask = true
        McuEcmErrorSource57:
          McuEcmErrorMaskableInterrupt = false
          McuEcmErrorNonMaskableInterrupt = false
          McuEcmErrorInternalReset = false
          McuEcmErrorNMIDelayTimer = false
          McuEcmErrorMIDelayTimer = false
          McuEcmErrorOutputMask = true
        McuEcmErrorSource64:
          McuEcmErrorMaskableInterrupt = false
          McuEcmErrorNonMaskableInterrupt = false
          McuEcmErrorInternalReset = false
          McuEcmErrorNMIDelayTimer = false
          McuEcmErrorMIDelayTimer = false
          McuEcmErrorOutputMask = true
        McuEcmErrorSource65:
          McuEcmErrorMaskableInterrupt = false
          McuEcmErrorNonMaskableInterrupt = false
          McuEcmErrorInternalReset = false
          McuEcmErrorNMIDelayTimer = false
          McuEcmErrorMIDelayTimer = false
          McuEcmErrorOutputMask = true
        McuEcmErrorSource66:
          McuEcmErrorMaskableInterrupt = false
          McuEcmErrorNonMaskableInterrupt = false
          McuEcmErrorInternalReset = false
          McuEcmErrorNMIDelayTimer = false
          McuEcmErrorMIDelayTimer = false
          McuEcmErrorOutputMask = true
        McuEcmErrorSource67:
          McuEcmErrorMaskableInterrupt = false
          McuEcmErrorNonMaskableInterrupt = false
          McuEcmErrorInternalReset = false
          McuEcmErrorNMIDelayTimer = false
          McuEcmErrorMIDelayTimer = false
          McuEcmErrorOutputMask = true
        McuEcmErrorSource72:
          McuEcmErrorMaskableInterrupt = false
          McuEcmErrorNonMaskableInterrupt = false
          McuEcmErrorInternalReset = false
          McuEcmErrorNMIDelayTimer = false
          McuEcmErrorMIDelayTimer = false
          McuEcmErrorOutputMask = true
        McuEcmErrorSource73:
          McuEcmErrorMaskableInterrupt = false
          McuEcmErrorNonMaskableInterrupt = false
          McuEcmErrorInternalReset = false
          McuEcmErrorNMIDelayTimer = false
          McuEcmErrorMIDelayTimer = false
          McuEcmErrorOutputMask = true
        McuEcmErrorSource74:
          McuEcmErrorMaskableInterrupt = false
          McuEcmErrorNonMaskableInterrupt = false
          McuEcmErrorInternalReset = false
          McuEcmErrorNMIDelayTimer = false
          McuEcmErrorMIDelayTimer = false
          McuEcmErrorOutputMask = true
        McuEcmErrorSource75:
          McuEcmErrorMaskableInterrupt = false
          McuEcmErrorNonMaskableInterrupt = false
          McuEcmErrorInternalReset = false
          McuEcmErrorNMIDelayTimer = false
          McuEcmErrorMIDelayTimer = false
          McuEcmErrorOutputMask = true
        McuEcmErrorSource76:
          McuEcmErrorMaskableInterrupt = false
          McuEcmErrorNonMaskableInterrupt = false
          McuEcmErrorInternalReset = false
          McuEcmErrorNMIDelayTimer = false
          McuEcmErrorMIDelayTimer = false
          McuEcmErrorOutputMask = true
        McuEcmErrorSource77:
          McuEcmErrorMaskableInterrupt = false
          McuEcmErrorNonMaskableInterrupt = false
          McuEcmErrorInternalReset = false
          McuEcmErrorNMIDelayTimer = false
          McuEcmErrorMIDelayTimer = false
          McuEcmErrorOutputMask = true
        McuEcmErrorSource78:
          McuEcmErrorMaskableInterrupt = false
          McuEcmErrorNonMaskableInterrupt = false
          McuEcmErrorInternalReset = false
          McuEcmErrorNMIDelayTimer = false
          McuEcmErrorMIDelayTimer = false
          McuEcmErrorOutputMask = true
        McuEcmErrorSource79:
          McuEcmErrorMaskableInterrupt = false
          McuEcmErrorNonMaskableInterrupt = false
          McuEcmErrorInternalReset = false
          McuEcmErrorNMIDelayTimer = false
          McuEcmErrorMIDelayTimer = false
          McuEcmErrorOutputMask = true
        McuEcmErrorSource80:
          McuEcmErrorMaskableInterrupt = false
          McuEcmErrorNonMaskableInterrupt = false
          McuEcmErrorInternalReset = false
          McuEcmErrorNMIDelayTimer = false
          McuEcmErrorMIDelayTimer = false
          McuEcmErrorOutputMask = true
        McuEcmErrorSource81:
          McuEcmErrorMaskableInterrupt = false
          McuEcmErrorNonMaskableInterrupt = false
          McuEcmErrorInternalReset = false
          McuEcmErrorNMIDelayTimer = false
          McuEcmErrorMIDelayTimer = false
          McuEcmErrorOutputMask = true
        McuEcmErrorSource82:
          McuEcmErrorMaskableInterrupt = false
          McuEcmErrorNonMaskableInterrupt = false
          McuEcmErrorInternalReset = false
          McuEcmErrorNMIDelayTimer = false
          McuEcmErrorMIDelayTimer = false
          McuEcmErrorOutputMask = true
        McuEcmErrorSource83:
          McuEcmErrorMaskableInterrupt = false
          McuEcmErrorNonMaskableInterrupt = false
          McuEcmErrorInternalReset = false
          McuEcmErrorNMIDelayTimer = false
          McuEcmErrorMIDelayTimer = false
          McuEcmErrorOutputMask = true
        McuEcmErrorSource84:
          McuEcmErrorMaskableInterrupt = false
          McuEcmErrorNonMaskableInterrupt = false
          McuEcmErrorInternalReset = false
          McuEcmErrorNMIDelayTimer = false
          McuEcmErrorMIDelayTimer = false
          McuEcmErrorOutputMask = true
        McuEcmErrorSource87:
          McuEcmErrorMaskableInterrupt = false
          McuEcmErrorNonMaskableInterrupt = false
          McuEcmErrorInternalReset = false
          McuEcmErrorNMIDelayTimer = false
          McuEcmErrorMIDelayTimer = false
          McuEcmErrorOutputMask = true
        McuEcmErrorSource88:
          McuEcmErrorMaskableInterrupt = false
          McuEcmErrorNonMaskableInterrupt = false
          McuEcmErrorInternalReset = false
          McuEcmErrorNMIDelayTimer = false
          McuEcmErrorMIDelayTimer = false
          McuEcmErrorOutputMask = true
        McuEcmErrorSource89:
          McuEcmErrorMaskableInterrupt = false
          McuEcmErrorNonMaskableInterrupt = false
          McuEcmErrorInternalReset = false
          McuEcmErrorNMIDelayTimer = false
          McuEcmErrorMIDelayTimer = false
          McuEcmErrorOutputMask = true
        McuEcmErrorSource90:
          McuEcmErrorMaskableInterrupt = false
          McuEcmErrorNonMaskableInterrupt = false
          McuEcmErrorInternalReset = false
          McuEcmErrorNMIDelayTimer = false
          McuEcmErrorMIDelayTimer = false
          McuEcmErrorOutputMask = true
        McuEcmErrorSource91:
          McuEcmErrorMaskableInterrupt = false
          McuEcmErrorNonMaskableInterrupt = false
          McuEcmErrorInternalReset = false
          McuEcmErrorNMIDelayTimer = false
          McuEcmErrorMIDelayTimer = false
          McuEcmErrorOutputMask = true
        McuEcmErrorSource92:
          McuEcmErrorMaskableInterrupt = false
          McuEcmErrorNonMaskableInterrupt = false
          McuEcmErrorInternalReset = false
          McuEcmErrorNMIDelayTimer = false
          McuEcmErrorMIDelayTimer = false
          McuEcmErrorOutputMask = true
        McuEcmErrorSource93: McuEcmErrorInternalReset=false, McuEcmErrorOutputMask=true
      McuDemEventParameterRefs:
        MCU_E_CLOCK_FAILURE = DemEventParameter1
        MCU_E_WRITE_TIMEOUT_FAILURE = DemEventParameter9
        MCU_E_POWERDOWN_MODE_FAILURE = DemEventParameter7
        MCU_E_CVM_DIAG_LOCK_FAILURE = DemEventParameter2
        MCU_E_CVM_SELFDIAG_FAILURE = DemEventParameter3
        MCU_E_ECM_SELFDIAG_FAILURE = DemEventParameter4
        MCU_E_INT_INCONSISTENT = DemEventParameter5
        MCU_E_LOCKSTEP_SELFDIAG_FAILURE = DemEventParameter6
        MCU_E_REG_WRITE_VERIFY = DemEventParameter8
        MCU_E_CLM_SELFDIAG_FAILURE = DemEventParameter0
      McuModeSettingConf:
        McuMode = 1
        McuModeType = MCU_HALT_MODE
        McuMcanStopTrigger = false
        McuFlexrayStopTrigger = false
        McuGtmStopTrigger = false
        McuEthernetStopTrigger = false
        McuRsentStopTrigger = false
        McuHsUsrtStopTrigger = false
        McuCsihStopTrigger = false
        McuRlin3StopTrigger = false
        McuAdcStopTrigger = false
        McuMcanWakeUpTrigger = false
        McuFlexrayWakeupTrigger = false
        McuGtmWakeupTrigger = false
        McuEthernetWakeupTrigger = false
        McuRsentWakeupTrigger = false
        McuHsUsrtWakeupTrigger = false
        McuCsihWakeupTrigger = false
        McuRlin3WakeupTrigger = false
        McuAdcWakeupTrigger = false
        McuWakeUpFactorDetails: McuWakeUpFactorName=INTECMMI
      McuRamSectorSettingConf: McuRamDefaultValue=255, McuRamSectionBaseAddress=4276027392, McuRamSectionSize=256
